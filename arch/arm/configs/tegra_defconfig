## drivers/media/video/tegra/Kconfig
```kconfig
source "drivers/media/video/tegra/avp/Kconfig"
source "drivers/media/video/tegra/mediaserver/Kconfig"

config TEGRA_CAMERA
        bool "Enable support for tegra camera/isp hardware"
        depends on ARCH_TEGRA
        default y
        help
          Enables support for the Tegra camera interface

          If unsure, say Y

config VIDEO_OV5650
        tristate "OV5650 camera sensor support"
        depends on I2C && ARCH_TEGRA
        ---help---
          This is a driver for the Omnivision OV5650 5MP camera sensor
          for use with the tegra isp.

config VIDEO_OV2710
        tristate "OV2710 camera sensor support"
        depends on I2C && ARCH_TEGRA
        ---help---
          This is a driver for the Omnivision OV2710 camera sensor
          for use with the tegra isp.

config TORCH_SSL3250A
        tristate "SSL3250A flash/torch support"
        depends on I2C && ARCH_TEGRA
        ---help---
          This is a driver for the SSL3250A flash/torch camera device

config VIDEO_SH532U
        tristate "SH532U focuser support"
        depends on I2C && ARCH_TEGRA
        ---help---
          This is a driver for the SEMCO SH532U focuser
          for use with the tegra isp.

config VIDEO_YUV
        tristate "YUV camera sensor support"
        depends on I2C && ARCH_TEGRA
        ---help---
          This is a template driver for all YUV camera sensor

config VIDEO_YUV_OV5640
        tristate "OV5640 YUV camera sensor support"
        depends on I2C && ARCH_TEGRA
        ---help---
          This is a driver for OV5640 YUV camera sensor

config VIDEO_YUV_MI1040
        tristate "MI1040 YUV camera sensor support"
        depends on I2C && ARCH_TEGRA
        ---help---
          This is a driver for MI1040 YUV camera sensor

config VIDEO_YUV_MI5140
        tristate "MI5140 YUV camera sensor support"
        depends on I2C && ARCH_TEGRA
        ---help---
          This is a driver for MI5140 YUV camera sensor
```
